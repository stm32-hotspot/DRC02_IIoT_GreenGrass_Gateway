## layers/meta-amefae-connectivity/conf/layer.conf
```bitbake
# We have a conf and classes directory, add to BBPATH
BBPATH .= ":${LAYERDIR}"

# We have recipes-* directories, add to BBFILES
BBFILES += "${LAYERDIR}/recipes-*/*/*.bb \
            ${LAYERDIR}/recipes-*/*/*.bbappend"

BBFILE_COLLECTIONS += "meta-amefae-connectivity"
BBFILE_PATTERN_meta-amefae-connectivity = "^${LAYERDIR}/"
BBFILE_PRIORITY_meta-amefae-connectivity = "8"

LAYERDEPENDS_meta-amefae-connectivity = "core"
LAYERSERIES_COMPAT_meta-amefae-connectivity = "dunfell"

IMAGE_INSTALL_append = " wpa-supplicant dhcp-client "
EXTRA_IMAGE_FEATURES ?= "debug-tweaks ssh-server-openssh"
```

## layers/meta-amefae-greengrass/conf/layer.conf
```bitbake
# We have a conf and classes directory, add to BBPATH
BBPATH .= ":${LAYERDIR}"

# We have recipes-* directories, add to BBFILES
BBFILES += "${LAYERDIR}/recipes-*/*/*.bb \
            ${LAYERDIR}/recipes-*/*/*.bbappend"

BBFILE_COLLECTIONS += "meta-amefae-greengrass"
BBFILE_PATTERN_meta-amefae-greengrass = "^${LAYERDIR}/"
BBFILE_PRIORITY_meta-amefae-greengrass = "8"

LAYERDEPENDS_meta-amefae-greengrass = "core"
LAYERSERIES_COMPAT_meta-amefae-greengrass = "dunfell"

IMAGE_INSTALL_append = " greengrass-bin-demo aws-iot-device-sdk-python-v2 greengrass-bin \
                          docker python3-pip bluez5"

IMAGE_ROOTFS_SIZE = "1762336"

DISTRO_FEATURES_append = "systemd virtualization bluetooth bluez5 "
DISTRO_FEATURES_BACKFILL_CONSIDERED = "sysvinit"
VIRTUAL-RUNTIME_init_manager = "systemd"
VIRTUAL-RUNTIME_initscripts = ""
```
